## config/boards/shields/slily58/Kconfig.defconfig
```kconfig
if SHIELD_SLILY58_LEFT

config ZMK_KEYBOARD_NAME
	default "SLily58"

config ZMK_SPLIT_ROLE_CENTRAL
	default y

endif

if SHIELD_SLILY58_LEFT || SHIELD_SLILY58_RIGHT

config ZMK_SPLIT
	default y

endif
```

## config/boards/shields/slily58/Kconfig.shield
```kconfig
config SHIELD_SLILY58_LEFT
	def_bool $(shields_list_contains,slily58_left)

config SHIELD_SLILY58_RIGHT
	def_bool $(shields_list_contains,slily58_right)
```
